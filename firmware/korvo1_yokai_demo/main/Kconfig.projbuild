## firmware/korvo1_yokai_demo/main/Kconfig.projbuild
```kconfig
menu "Yokai Demo Configuration"

    config YOKAI_WIFI_SSID
        string "WiFi SSID"
        default ""
        help
            SSID for Wi-Fi station connection to fetch weather and sync SNTP.

    config YOKAI_WIFI_PASSWORD
        string "WiFi Password"
        default ""
        help
            Password for Wi-Fi station.

    config YOKAI_WEATHER_LATITUDE
        string "Weather Latitude"
        default "35.6895"
        help
            Latitude for weather query (default Tokyo 35.6895).

    config YOKAI_WEATHER_LONGITUDE
        string "Weather Longitude"
        default "139.6917"
        help
            Longitude for weather query (default Tokyo 139.6917).

endmenu
```

## firmware/korvo1_yokai_demo/sdkconfig.defaults.esp32p4
```kconfig
# ESP32-P4X v3.1+ with official 1024x600 display and CSI camera.
CONFIG_ESP32P4_SELECTS_REV_LESS_V3=n
CONFIG_ESP_DEFAULT_CPU_FREQ_MHZ_400=y
CONFIG_SPIRAM_SPEED_200M=y
CONFIG_ESPTOOLPY_FLASHFREQ_80M=y
CONFIG_SPI_FLASH_AUTO_SUSPEND=n
CONFIG_BT_ENABLED=n
CONFIG_BSP_LCD_TYPE_1024_600=y
CONFIG_BSP_LCD_DPI_BUFFER_NUMS=2
CONFIG_ESP_WIFI_REMOTE_ENABLED=y
CONFIG_ESP_WIFI_REMOTE_LIBRARY_HOSTED=y
CONFIG_CAMERA_SC2336=y
CONFIG_CAMERA_SC2336_AUTO_DETECT_MIPI_INTERFACE_SENSOR=y
CONFIG_CAMERA_SC2336_MIPI_RAW10_1280X720_30FPS=y
CONFIG_CAMERA_SC2336_MIPI_DEFAULT_FMT_RAW10_1280X720_30FPS=y
CONFIG_ESP_HOSTED_HOST_TRANSPORT_BUS_SDIO=y
CONFIG_ESP_HOSTED_HOST_SDIO_PIN_CLK=18
CONFIG_ESP_HOSTED_HOST_SDIO_PIN_CMD=19
CONFIG_ESP_HOSTED_HOST_SDIO_PIN_D0=14
CONFIG_ESP_HOSTED_HOST_SDIO_PIN_D1=15
CONFIG_ESP_HOSTED_HOST_SDIO_PIN_D2=16
CONFIG_ESP_HOSTED_HOST_SDIO_PIN_D3=17
CONFIG_ESP_HOSTED_HOST_RESET_GPIO=54
CONFIG_ESP_HOSTED_SD_PWR_CTRL_LDO_INTERNAL_IO=n
```

## firmware/korvo1_yokai_demo/sdkconfig.defaults.esp32s31
```kconfig
CONFIG_IDF_TARGET_ESP32S31=y
CONFIG_SPIRAM_SPEED_250M=y
CONFIG_ESP_DEFAULT_CPU_FREQ_MHZ_320=y
CONFIG_BSP_LCD_RGB_BUFFER_NUMS=2
CONFIG_BT_ENABLED=y
CONFIG_BTDM_CTRL_MODE_BR_EDR_ONLY=y
CONFIG_BT_BLUEDROID_ENABLED=y
CONFIG_BT_CLASSIC_ENABLED=y
CONFIG_BT_A2DP_ENABLE=y
CONFIG_BT_BLE_ENABLED=n
CONFIG_BT_CTRL_ALLOW_MALLOC_FROM_SPIRAM=y
CONFIG_BT_ALLOCATION_FROM_SPIRAM_FIRST=y
CONFIG_BT_BLUEDROID_TASK_STACK_IN_EXT_MEM=y
CONFIG_CAMERA_OV3660=y
CONFIG_CAMERA_OV3660_AUTO_DETECT_DVP_INTERFACE_SENSOR=y
CONFIG_CAMERA_OV3660_DVP_RGB565_BE_240X240_24FPS=y
CONFIG_CAMERA_OV3660_DVP_RGB565_BE_640X480_10FPS=y
CONFIG_CAMERA_OV3660_DVP_YUV422_YUYV_640X480_10FPS=y
CONFIG_CAMERA_OV3660_DVP_DEFAULT_FMT_RGB565_BE_640X480_10FPS=y
CONFIG_CAMERA_SC030IOT=y
CONFIG_CAMERA_SC030IOT_AUTO_DETECT_DVP_INTERFACE_SENSOR=y
CONFIG_CAMERA_SC030IOT_DVP_YUV422_640X480_26FPS=y
CONFIG_CAMERA_SC030IOT_DVP_DEFAULT_FMT_YUV422_640X480_26FPS=y
CONFIG_CAMERA_SC030IOT_DVP_IF_FORMAT_INDEX_DEFAULT=0
CONFIG_CAMERA_SC101IOT=y
CONFIG_CAMERA_SC101IOT_AUTO_DETECT_DVP_INTERFACE_SENSOR=y
CONFIG_CAMERA_SC101IOT_DVP_YUV422_1280X720_15FPS=y
CONFIG_CAMERA_SC101IOT_DVP_DEFAULT_FMT_YUV422_1280X720_15FPS=y
CONFIG_CAMERA_SC101IOT_DVP_IF_FORMAT_INDEX_DEFAULT=0
```
